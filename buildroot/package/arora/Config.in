## buildroot/package/arora/Config.in
```kconfig
config BR2_PACKAGE_ARORA
        bool "arora"
    select BR2_PACKAGE_QT
    select BR2_PACKAGE_QT_WEBKIT
    select BR2_PACKAGE_QT_GIF
    select BR2_PACKAGE_QT_QTJPEG
    select BR2_PACKAGE_QT_QTPNG
        help
          Arora web browser 
```

## buildroot/package/con2fbmap/Config.in
```kconfig
config BR2_PACKAGE_CON2FBMAP
        bool "con2fbmap"
    ### build dependencies
    ### runtime dependencies
        help
          Change tty console to a different framebuffer device /dev/fbX
```

## buildroot/package/p7zip/Config.in
```kconfig
config BR2_PACKAGE_P7ZIP
        bool "p7zip"
        help
          Installs 7z (without rar support)

          http://p7zip.sourceforge.net/ 
```

## buildroot/package/partclone/Config.in
```kconfig
config BR2_PACKAGE_PARTCLONE
	bool "partclone"
	help
	  Partclone
	  Note: only installs partclone.restore

	  http://partclone.org

comment "partclone requires a toolchain with LARGEFILE+WCHAR support"
        depends on !(BR2_LARGEFILE && BR2_USE_WCHAR)
```

## buildroot/package/recovery/Config.in
```kconfig
config BR2_PACKAGE_RECOVERY
        bool "recovery"
    ### build dependencies
    select BR2_PACKAGE_QT
    select BR2_PACKAGE_QT_QTPNG
    select BR2_PACKAGE_QT_GFX_LINUXFB
    select BR2_PACKAGE_QT_GFX_VNC
    select BR2_PACKAGE_QT_QTFREETYPE
    select BR2_PACKAGE_QT_SYSTEMZLIB
    select BR2_PACKAGE_QT_MOUSE_PC
    select BR2_PACKAGE_QT_KEYBOARD_TTY
    select BR2_PACKAGE_QJSON
    select BR2_PACKAGE_WPA_SUPPLICANT
    ### runtime dependencies
    # commands called from the init script: mount, hostname, echo, getty, grep, ifup, vcgencmd, sh, cat, recovery
    # commands called from recovery application using QProcess:
    #    main.cpp: umount, ifdown
    #    util.cpp: mknod
    #    bootselectiondialog.cpp: mount, sh, tvservice, cut
    #    mainwindow.cpp: umount, mount, mkfs.ext4, sh, tvservice, cut, echo, sleep, arora, ifconfig, ifup, tar
    #    languagedialog.cpp: mount
    #    initdrivethread.cpp: parted, sfdisk, partprobe, mlabel, cp, rm, du, mount, umount, mkfs.fat, mkfs.ext4, dd
    #    confeditdialog.cpp: mount, umount
    #    multiimagewritethread.cpp: mount, umount, sh, partprobe, mkfs.fat, mkfs.ext4, findfs, sh, wget, gzip, xz, bzip2, lzop, unzip, tar, dd, blkid
    #
    # busybox provides: mount, hostname, echo, getty, grep, ifup, sh, cat, umount, ifdown, mknod, cut, sleep, ifconfig, tar, cp, rm, du, dd, gzip, xz, bzip2, lzop, unzip
    select BR2_PACKAGE_RPI_USERLAND # vcgencmd, tvservice
    select BR2_PACKAGE_E2FSPROGS
    select BR2_PACKAGE_E2FSPROGS_MKE2FS # mkfs.ext4
    select BR2_PACKAGE_ARORA # arora
    select BR2_PACKAGE_PARTED # parted, partprobe
    select BR2_PACKAGE_UTIL_LINUX # sfdisk, findfs, blkid
    select BR2_PACKAGE_MTOOLS # mlabel
    select BR2_PACKAGE_DOSFSTOOLS
    select BR2_PACKAGE_DOSFSTOOLS_MKFS_FAT # mkfs.fat
    select BR2_PACKAGE_WGET # wget
        help
          recovery GUI 
```
